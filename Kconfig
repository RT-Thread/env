## Kconfig
```kconfig
config PKGS_DIR
    string
    option env="PKGS_ROOT"
    default "packages"

config TARGET_FILE
    string
    default ""

config HOSTOS
    string
    option env="Windows"
    default "Linux"

source "$PKGS_DIR/sdk/$HOSTOS/Kconfig"
```

## cmds/Kconfig
```kconfig
menu "Env config"

config SYS_AUTO_UPDATE_PKGS
    bool "Auto update pkgs config"
    default y

choice
    prompt "Select download server"
    config SYS_DOWNLOAD_SERVER_AUTO
        bool "Auto"

    config SYS_DOWNLOAD_SERVER_GITHUB
        bool "Github"

    config SYS_DOWNLOAD_SERVER_GITEE
        bool "Gitee"
endchoice

config SYS_CREATE_MDK_IAR_PROJECT
    bool "Auto create a Keil-MDK or IAR project"
    default n

if SYS_CREATE_MDK_IAR_PROJECT

    choice
        prompt "Project type"
        help 
            Select the project type mdk or iar
            
        config SYS_CREATE_MDK5
            bool "MDK5"

        config SYS_CREATE_IAR
            bool "IAR"

        config SYS_CREATE_MDK4
            bool "MDK4"
    endchoice

    config SYS_CREATE_MDK_EXEC_PATH
        string "MDK Path"
        depends on SYS_CREATE_MDK5 || SYS_CREATE_MDK4
        default "C:/Keil_v5"

    config SYS_CREATE_IAR_EXEC_PATH
        string "IAR Path"
        depends on SYS_CREATE_IAR
        default "C:/Program Files (x86)/IAR Systems/Embedded Workbench 8.3"

endif

config SYS_PKGS_USING_STATISTICS
    bool "Send usage data for improve product"
    default y
    help
        Reads the user's mac address and returns it to the rt-thread official, 
        which is used to count the number of users

endmenu
```
